## src/sdc/Kconfig
```kconfig
menuconfig ZMK_BT_LL_SOFTDEVICE
	bool "Use Nordic SoftDevice Controller"
	depends on SOC_NRF52840
	depends on BT
	depends on !BT_LL_SW_SPLIT
	select HAS_BT_CTLR
	select BT_CTLR
	select ZERO_LATENCY_IRQS
	select BT_HAS_HCI_VS
	select BT_CTLR_SUBRATING_SUPPORT
	select BT_CTLR_PHY_UPDATE_SUPPORT
	select BT_CTLR_PHY_2M_SUPPORT
	select BT_CTLR_DATA_LEN_UPDATE_SUPPORT
	select BT_CTLR_LE_ENC_SUPPORT
	select BT_CTLR_EXT_REJ_IND_SUPPORT
	select BT_CTLR_PRIVACY_SUPPORT
	select BT_CTLR_CONN_RSSI_SUPPORT
	select BT_CTLR_LE_POWER_CONTROL_SUPPORT
	select BT_CTLR_CHAN_SEL_2_SUPPORT
	select BT_CTLR_ADV_EXT_SUPPORT
	select BT_CTLR_CRYPTO_SUPPORT
	select BT_CTLR_ENTROPY_SUPPORT
	select CLOCK_CONTROL_NRF_FORCE_ALT
	help
	  Use Nordic's SoftDevice Controller instead of Zephyr's built-in
	  software link layer (BT_LL_SW_SPLIT).

	  This provides better power efficiency and support for advanced
	  Bluetooth 5.3+ features like Connection Subrating.

if ZMK_BT_LL_SOFTDEVICE

# ============================================================================
# SDC Variant Selection
# ============================================================================

choice ZMK_SDC_VARIANT
	prompt "SoftDevice Controller variant"
	default ZMK_SDC_MULTIROLE

config ZMK_SDC_MULTIROLE
	bool "Multirole (Central + Peripheral)"
	help
	  Full-featured variant supporting both central and peripheral roles.
	  Required for ZMK split keyboards.

config ZMK_SDC_PERIPHERAL
	bool "Peripheral only"
	help
	  Smaller code size variant for peripheral-only devices.

config ZMK_SDC_CENTRAL
	bool "Central only"
	help
	  Smaller code size variant for central-only devices.

endchoice

# ============================================================================
# MPSL Configuration
# ============================================================================

config MPSL_THREAD_COOP_PRIO
	int "MPSL thread cooperative priority"
	default 8
	help
	  Cooperative priority of the MPSL work handler thread.

config MPSL_WORK_STACK_SIZE
	int "MPSL work handler thread stack size"
	default 1024
	help
	  Stack size for the MPSL work handler thread.

config MPSL_TIMESLOT_SESSION_COUNT
	int "Number of MPSL timeslot sessions"
	default 0
	help
	  Maximum number of timeslot sessions.

config MPSL_LOW_PRIO_IRQN
	int "MPSL low priority IRQ number"
	default 25 if SOC_SERIES_NRF52X
	help
	  IRQ number for MPSL low-priority processing (SWI5 on nRF52).

config MPSL_HFCLK_LATENCY
	int "HFCLK startup latency (microseconds)"
	default 1400
	help
	  Time MPSL assumes for HFCLK to become available after request.

config MPSL_ASSERT_HANDLER
	bool "Application-defined MPSL assertion handler"
	help
	  Enable application-defined handler for MPSL assertions.

config MPSL_DYNAMIC_INTERRUPTS
	bool "Use dynamic interrupts for MPSL"
	depends on DYNAMIC_DIRECT_INTERRUPTS
	help
	  Configure MPSL IRQ handlers using direct dynamic interrupts.

config MPSL_INIT_PRIORITY
	int "MPSL initialization priority"
	default 50
	help
	  System initialization priority for MPSL.

config BT_LL_SOFTDEVICE_INIT_PRIORITY
	int "SoftDevice Controller initialization priority"
	default 51
	help
	  System initialization priority for the SoftDevice Controller.
	  Must be higher than MPSL_INIT_PRIORITY.

# ============================================================================
# SDC Connection Configuration
# ============================================================================

config BT_CTLR_SDC_CENTRAL_COUNT
	int "Number of concurrent central roles"
	default 0 if !BT_CENTRAL
	default ZMK_SPLIT_BLE_CENTRAL_PERIPHERALS if ZMK_SPLIT_ROLE_CENTRAL
	default 1 if BT_CENTRAL
	range 0 BT_MAX_CONN
	help
	  Number of concurrent central connections (for split peripherals).
	  The peripheral count is derived as: BT_MAX_CONN - BT_CTLR_SDC_CENTRAL_COUNT

	  For ZMK split central, defaults to ZMK_SPLIT_BLE_CENTRAL_PERIPHERALS.

config BT_CTLR_SDC_TX_PACKET_COUNT
	int "TX packet buffers per connection"
	default 3
	range 1 20
	help
	  Number of TX packet buffers per connection.

config BT_CTLR_SDC_RX_PACKET_COUNT
	int "RX packet buffers per connection"
	default 2
	range 1 20
	help
	  Number of RX packet buffers per connection.

config BT_CTLR_SDC_MAX_CONN_EVENT_LEN_DEFAULT
	int "Default max connection event length (us)"
	default 7500
	help
	  Maximum time in microseconds for a connection event.

config BT_CTLR_SDC_CONN_EVENT_EXTEND_DEFAULT
	bool "Enable connection event extension by default"
	default y
	help
	  Allow connection events to extend beyond the nominal length
	  when there are queued packets. Lets multiple HID reports go
	  out in a single connection event instead of waiting for the
	  next interval.

config BT_CTLR_SDC_LLPM
	bool "Enable Low Latency Packet Mode (LLPM)"
	depends on BT_CONN
	help
	  Enable Nordic's LLPM, which allows connection intervals
	  of 1-7ms (in 1ms steps) via vendor-specific HCI commands.
	  Standard BLE minimum is 7.5ms.
	  LLPM mode is enabled during SDC init; per-connection interval
	  changes are made via the ZMK_BLE_LLPM module.

config BT_CTLR_SDC_CENTRAL_ACL_EVENT_SPACING_DEFAULT
	int "Default central ACL event spacing (us)"
	depends on BT_CENTRAL
	default BT_CTLR_SDC_MAX_CONN_EVENT_LEN_DEFAULT
	help
	  On the central, sets the time ACL connections are spaced apart
	  assuming they are using the same connection interval.

config BT_CTLR_SDC_RX_PRIO
	int "SDC RX thread priority"
	default 6
	help
	  Priority of the SDC receive thread.

config BT_CTLR_SDC_SCAN_BUFFER_COUNT
	int "Scanner buffer count"
	default 3
	range 2 20
	help
	  Number of buffers for scanner operation.

config BT_CTLR_FAL_SIZE
	int "Filter Accept List size"
	default 8
	range 0 255
	help
	  Maximum addresses in the Filter Accept List.

config BT_CTLR_SDC_QOS_CONN_EVENT_REPORT
	bool "QoS connection event reports"
	help
	  Enable SoftDevice Controller QoS connection event reports.
	  Provides per-connection-event CRC ok/error counts per channel,
	  used by the BLE QoS channel map filter module.

config BT_CTLR_SDC_CONN_ANCHOR_POINT_REPORT
	bool "Connection anchor point update reports"
	help
	  Enable SoftDevice Controller connection anchor point update event
	  reports (VS subevent 0x82). On a central, this fires every connection
	  interval. On a peripheral, it fires for connection events in which a
	  packet from the central is received.

# ============================================================================
# BLE 6.0/6.2 Features (nrfxlib >= v3.2.0)
# ============================================================================

config BT_CTLR_EXTENDED_FEAT_SET
	bool "Extended Feature Set"
	depends on BT_CONN
	help
	  Enable BLE Extended Feature Set support. Prerequisite for
	  Frame Space Update and other BLE 6.0+ negotiation features.
	  Adds per-link memory for extended feature page exchange.

config BT_CTLR_SDC_EXTENDED_FEAT_MAX_REMOTE_PAGE
	int "Max extended feature pages to read from remote"
	depends on BT_CTLR_EXTENDED_FEAT_SET
	default 1
	range 1 10
	help
	  Maximum number of extended feature pages to read from
	  a remote device. Each page adds 24 bytes per link.

config BT_CTLR_FRAME_SPACE_UPDATE
	bool "Frame Space Update (BLE 6.0)"
	depends on BT_CONN
	help
	  Enable BLE 6.0 Frame Space Update, which allows negotiating
	  the inter-frame space between packets. On a split link this
	  can tighten timing to allow more retransmit opportunities
	  within a single connection event.

config BT_CTLR_SDC_ENABLE_LOWEST_FRAME_SPACE
	bool "Enable lowest frame space"
	depends on BT_CTLR_FRAME_SPACE_UPDATE
	help
	  Request the lowest possible frame space. Requires the same
	  PHY in both TX and RX directions.

config BT_CTLR_LE_FLUSHABLE_ACL_DATA
	bool "Flushable ACL Data (BLE 6.2)"
	depends on BT_CONN
	help
	  Enable BLE 6.2 Flushable ACL Data support. Allows setting
	  an automatic flush timeout per connection so stale ACL data
	  is discarded instead of retransmitted indefinitely. Useful
	  for mouse/trackpoint data on the split link where freshness
	  matters more than reliability.

# Reopen the flash driver's radio sync choice to inject the MPSL backend.
# The choice is originally defined in zephyr/drivers/flash/Kconfig.nrf with
# TICKER (for BT_LL_SW_SPLIT) and NONE.  We add a third option that uses
# MPSL timeslots — identical to what NCS does in sdk-nrf.

if SOC_FLASH_NRF

choice SOC_FLASH_NRF_RADIO_SYNC_CHOICE
	default SOC_FLASH_NRF_RADIO_SYNC_MPSL

config SOC_FLASH_NRF_RADIO_SYNC_MPSL
	bool "Nordic nRFx flash driver synchronized using MPSL"
	help
	  Enable synchronization between the flash memory driver and radio
	  using MPSL timeslots.  Flash operations are scheduled into idle
	  radio time, preventing any radio stalls during NVS writes/erases.

endchoice

config SOC_FLASH_NRF_RADIO_SYNC_MPSL_NORMAL_PRIORITY_TIMEOUT_US
	int "Timeout before escalating timeslot priority [us]"
	depends on SOC_FLASH_NRF_RADIO_SYNC_MPSL
	default 10000
	help
	  Initially flash timeslots are requested at normal priority.
	  After this timeout (in microseconds) without obtaining a slot,
	  the request is re-issued at high priority to ensure forward
	  progress even under heavy radio traffic.

config SOC_FLASH_NRF_RADIO_SYNC_MPSL_TIMESLOT_SESSION_COUNT
	int
	default 1 if SOC_FLASH_NRF_RADIO_SYNC_MPSL
	default 0

endif # SOC_FLASH_NRF

# ============================================================================
# Logging
# ============================================================================

module = SDC
module-str = SDC
source "subsys/logging/Kconfig.template.log_config"

module = MPSL
module-str = MPSL
source "subsys/logging/Kconfig.template.log_config"

endif # ZMK_BT_LL_SOFTDEVICE
```
