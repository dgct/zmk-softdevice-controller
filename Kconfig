## src/esb/Kconfig
```kconfig
#
# Copyright (c) 2018 Nordic Semiconductor ASA
#
# SPDX-License-Identifier: LicenseRef-Nordic-5-Clause
#

menuconfig ESB
	bool "Enhanced ShockBurst"
	select NRFX_GPPI
	help
	  Enable ESB functionality.

if ESB

config ESB_MAX_PAYLOAD_LENGTH
	int "Maximum payload size"
	default 32
	range 1 252
	help
	  The maximum size of the payload.

config ESB_TX_FIFO_SIZE
	int "TX buffer length"
	default 8
	help
	  The length of the TX FIFO buffer, in number of elements.

config ESB_RX_FIFO_SIZE
	int "RX buffer length"
	default 8
	help
	  The length of the RX FIFO buffer, in number of elements.

config ESB_PIPE_COUNT
	int "Maximum number of pipes"
	default 8
	range 1 8
	help
	  The maximum number of pipes allowed in the API. Can be used if you
	  need to restrict the number of pipes used. The purpose is to prevent
	  accidental use of additional pipes, but it's not a problem leaving
	  this at 8 even if fewer pipes are used.

config ESB_RADIO_IRQ_PRIORITY
	int "Radio interrupt priority"
	range 0 5 if ZERO_LATENCY_IRQS
	range 0 6
	default 1

config ESB_EVENT_IRQ_PRIORITY
	int "Event interrupt priority"
	range 0 5 if ZERO_LATENCY_IRQS
	range 0 6
	default 2

menu "Hardware selection (alter with care)"

choice ESB_SYS_TIMER
	# defaults to match ESB_TIMER with MPSL_TIMER0
	default ESB_SYS_TIMER0 if ESB_MPSL_TIMESLOT
	default ESB_SYS_TIMER10 if ESB_MPSL_TIMESLOT
	default ESB_SYS_TIMER020 if ESB_MPSL_TIMESLOT
	default ESB_SYS_TIMER2 if ESB_TICKER_TIMESLOT
	default ESB_SYS_TIMER021 if $(dt_nodelabel_has_compat,timer021,$(DT_COMPAT_NORDIC_NRF_TIMER))
	default ESB_SYS_TIMER10 if $(dt_nodelabel_has_compat,timer10,$(DT_COMPAT_NORDIC_NRF_TIMER))
	default ESB_SYS_TIMER2
	prompt "Timer to use for the ESB system timer"

config ESB_SYS_TIMER0
	bool "TIMER0"
	depends on $(dt_nodelabel_has_compat,timer0,$(DT_COMPAT_NORDIC_NRF_TIMER))
	select NRFX_TIMER

config ESB_SYS_TIMER1
	bool "TIMER1"
	depends on $(dt_nodelabel_has_compat,timer1,$(DT_COMPAT_NORDIC_NRF_TIMER))
	select NRFX_TIMER

config ESB_SYS_TIMER2
	bool "TIMER2"
	depends on $(dt_nodelabel_has_compat,timer2,$(DT_COMPAT_NORDIC_NRF_TIMER))
	select NRFX_TIMER

config ESB_SYS_TIMER3
	bool "TIMER3"
	depends on $(dt_nodelabel_has_compat,timer3,$(DT_COMPAT_NORDIC_NRF_TIMER))
	select NRFX_TIMER

config ESB_SYS_TIMER4
	bool "TIMER4"
	depends on $(dt_nodelabel_has_compat,timer4,$(DT_COMPAT_NORDIC_NRF_TIMER))
	select NRFX_TIMER

config ESB_SYS_TIMER10
	bool "TIMER10"
	depends on $(dt_nodelabel_has_compat,timer10,$(DT_COMPAT_NORDIC_NRF_TIMER))
	select NRFX_TIMER

config ESB_SYS_TIMER020
	bool "TIMER020"
	depends on $(dt_nodelabel_has_compat,timer020,$(DT_COMPAT_NORDIC_NRF_TIMER))
	select NRFX_TIMER

config ESB_SYS_TIMER021
	bool "TIMER021"
	depends on $(dt_nodelabel_has_compat,timer021,$(DT_COMPAT_NORDIC_NRF_TIMER))
	select NRFX_TIMER

config ESB_SYS_TIMER022
	bool "TIMER022"
	depends on $(dt_nodelabel_has_compat,timer022,$(DT_COMPAT_NORDIC_NRF_TIMER))
	select NRFX_TIMER

endchoice

config ESB_SYS_TIMER_INSTANCE
	int
	default 0 if ESB_SYS_TIMER0
	default 1 if ESB_SYS_TIMER1
	default 2 if ESB_SYS_TIMER2
	default 3 if ESB_SYS_TIMER3
	default 4 if ESB_SYS_TIMER4
	default 10 if ESB_SYS_TIMER10
	default 20 if ESB_SYS_TIMER020
	default 21 if ESB_SYS_TIMER021
	default 22 if ESB_SYS_TIMER022

config ESB_SYS_TIMER_INSTANCE_LEADING_ZERO
	bool
	default y if ESB_SYS_TIMER020 || ESB_SYS_TIMER021 || ESB_SYS_TIMER022

endmenu

config ESB_DYNAMIC_INTERRUPTS
	bool "Use direct dynamic interrupts"
	select DYNAMIC_INTERRUPTS
	select DYNAMIC_DIRECT_INTERRUPTS
	help
	  This option configures ESB IRQ handlers using direct dynamic
	  interrupts. This allows reconfiguring ESB_SYS_TIMER_IRQn, ESB_EVT_IRQ,
	  and RADIO_IRQn handlers during runtime when ESB is uninitialized.

choice ESB_RADIO_MODE
	prompt "ESB radio access mode"
	depends on ESB
	default ESB_STANDALONE_RADIO
	help
	  Select how ESB accesses the radio. Standalone gives exclusive
	  access. MPSL Timeslot and BLE Controller Ticker allow concurrent
	  BLE operation.

config ESB_STANDALONE_RADIO
	bool "ESB standalone (exclusive radio)"
	depends on !ESB_NEVER_DISABLE_TX
	help
	  ESB has exclusive radio access. No concurrent BLE.

config ESB_MPSL_TIMESLOT
	bool "ESB on MPSL Timeslot [EXPERIMENTAL]"
	select EXPERIMENTAL
	select MPSL
	depends on !ESB_NEVER_DISABLE_TX
	depends on !SOC_SERIES_NRF53
	help
	  This option configures the ESB to use the MPSL Timeslot API as middleman in radio access.
	  It allows multiple protocols to be used concurrently. Using the Timeslot API can increase
	  number of retransmissions, reduce ESB packets delivery rate, and cause the delay of
	  retransmissions to vary.

config ESB_TICKER_TIMESLOT
	bool "ESB on BLE Controller Ticker"
	select EXPERIMENTAL
	select ESB_DYNAMIC_INTERRUPTS
	depends on BT_CTLR_USER_EXT
	depends on !ESB_NEVER_DISABLE_TX
	help
	  Uses the Zephyr open BLE LL ticker scheduler for ESB radio access.
	  ESB runs as a first-class ticker node alongside BLE connections,
	  eliminating the MPSL dependency. Requires BT_CTLR_USER_EXT to
	  register ESB as a proprietary ticker node in the controller.

endchoice

config ESB_TICKER_INTERVAL_US
	int "ESB ticker interval in microseconds"
	default 5000
	range 1250 20000
	depends on ESB_TICKER_TIMESLOT
	help
	  How often the ESB ticker node fires. Lower values give better
	  ESB latency but reduce BLE throughput. 5000 (5ms) matches the
	  default MPSL timeslot interval.

config ESB_TICKER_DIAG
	bool "Log ESB ticker diagnostic counters every 2 s"
	depends on ESB_TICKER_TIMESLOT
	help
	  Periodically logs prepare/done/abort counters from the ESB ticker
	  node. Off by default; the counters stay available through
	  esb_ticker_get_diag() (used by ZMK_ESB_STATS).

config ESB_TICKER_SLOT_US
	int "ESB ticker slot duration in microseconds (when not automatic)"
	default 2500
	range 500 10000
	depends on ESB_TICKER_TIMESLOT && !ESB_TICKER_SLOT_AUTO
	help
	  Duration of each ESB radio slot. Must be shorter than the
	  ticker interval to leave time for BLE events. The slot
	  includes radio ramp-up, RX listen, and ACK transmission.

config ESB_TICKER_SLOT_AUTO
	bool "Size the ESB ticker slot from the bitrate and payload length"
	default y
	depends on ESB_TICKER_TIMESLOT
	help
	  Slot = RX ramp-up + ESB_TICKER_SLOT_GUARD_US + on-air time of the
	  longest frame (ESB_MAX_PAYLOAD_LENGTH at the configured bitrate).
	  An ACK that is in flight when the slot expires is allowed to finish
	  before the slot closes, so the ACK is not part of the budget.

config ESB_TICKER_SLOT_GUARD_US
	int "Allowance in the automatic slot for the PTX aiming lead and jitter (us)"
	default 300
	range 50 2000
	depends on ESB_TICKER_SLOT_AUTO
	help
	  The phase-locked PTX aims its frame ZMK_ESB_TX_LEAD_US after the
	  window opens; this guard must cover that lead plus the timing
	  jitter of both sides (RTC tick 30.5 us, IRQ latency).

config ESB_TICKER_SLOT_RESERVE
	bool "Reserve the ESB slot in the ticker scheduler"
	default n
	depends on ESB_TICKER_TIMESLOT
	help
	  When set, the ESB ticker node reserves its slot like a BLE role does,
	  so the scheduler resolves collisions between ESB and BLE nodes (and
	  may skip ESB expiries that overlap a BLE reservation). When unset the
	  node is slot-less: it always expires and yields to any BLE event at
	  the LLL level instead. Slot-less is the coexistence policy this
	  driver is designed around.

config ESB_TICKER_START_DELAY_MS
	int "Delay before the ESB ticker starts once its preconditions hold (ms)"
	default 0
	range 0 10000
	depends on ESB_TICKER_TIMESLOT
	help
	  The ticker starts as soon as both esb_start_rx()/esb_start_tx() and
	  the controller's ull_user_init() have run. A delay only helps when a
	  console must come up first to see the earliest log lines.

config ESB_TICKER_YIELD_CONN_ONLY
	bool "Yield an ESB slot only to BLE connection events"
	default y
	depends on ESB_TICKER_TIMESLOT
	help
	  A running ESB slot is preempted only by a connection event (the host
	  link must never lose an anchor). Advertising, which has no timing
	  obligation, is refused while ESB is on the air and simply skips that
	  one advertising event, so the split link keeps working with no host
	  connected. Disable to yield to every BLE role as before.

config ESB_TICKER_ANCHOR_BLE
	bool "Align the ESB ticker to the BLE peripheral connection anchor"
	default y
	depends on ESB_TICKER_TIMESLOT && BT_PERIPHERAL
	help
	  On every ESB ticker expiry compare its phase with the host link's
	  connection ticker (peripheral role) and apply a drift correction so
	  the ESB slot always starts ESB_TICKER_ANCHOR_OFFSET_US after the
	  connection ticker expiry. With an ESB period that divides the
	  connection interval, the ESB slot then never overlaps the BLE
	  connection event. Without a peripheral connection the ticker
	  free-runs.

config ESB_TICKER_ANCHOR_OFFSET_US
	int "ESB ticker expiry offset after the connection ticker expiry (us)"
	default 2350
	range 0 20000
	depends on ESB_TICKER_ANCHOR_BLE
	help
	  The connection ticker expires EVENT_OVERHEAD_XTAL_US + EVENT_OVERHEAD_
	  START_US (1500 + 275 us on nRF52) before the on-air anchor point; a
	  typical peripheral connection event with one PDU pair lasts ~500 us
	  from the anchor. 2350 = 1775 + 500 + ~75 us guard. Raise it if the
	  host link carries several PDUs per event; lower it towards 1900 to
	  squeeze a 2 ms connection interval.

config ESB_TICKER_ANCHOR_TOLERANCE_US
	int "Phase error tolerated before a drift correction is applied (us)"
	default 61
	range 31 2000
	depends on ESB_TICKER_ANCHOR_BLE
	help
	  Two RTC ticks by default. Corrections are applied through
	  ticker_update() drift, never by restarting the ticker.

config ESB_NEVER_DISABLE_TX
	select EXPERIMENTAL
	bool "Never disable radio transmission stage"
	help
	  This option changes the radio behavior so that the
	  transmitter remains IDLE between transmissions instead of being disabled.
	  This is applicable only when the packet is not acknowledged. Otherwise,
	  the radio emitter needs to be turned off to enable the radio receiver.
	  This reduces delay between consecutive transmissions but consumes more energy.

config ESB_FAST_SWITCHING
	select EXPERIMENTAL
	depends on !ESB_NEVER_DISABLE_TX && (SOC_NRF54H20_CPURAD)
	bool "Fast radio TX/RX and RX/TX switching [EXPERIMENTAL]"
	help
	  This option enables fast switching between transmit (TX) and receive (RX) modes
	  and vice versa for ESB configurations.
	  For the PTX node, this switching occurs after transmitting a packet and before waiting
	  for acknowledgment (TX -> RX).
	  For the PRX node, this switching occurs after receiving a packet and before
	  transmitting an acknowledgment (RX -> TX).
	  Enabling this feature can improve the responsiveness and efficiency of the radio
	  communication system by reducing the latency.

config ESB_FAST_CHANNEL_SWITCHING
	select EXPERIMENTAL
	depends on SOC_NRF54H20_CPURAD
	bool "Fast radio channel switching [EXPERIMENTAL]"
	help
	  This option enables fast radio channel switching.
	  Allows the radio channel to be changed in RX radio state
	  without the need to switch the radio to DISABLE state.

config ESB_CLOCK_INIT
	bool "Initialize clocks during ESB initialization"
	depends on CLOCK_CONTROL_NRF || CLOCK_CONTROL_NRF2
	imply NRFX_POWER
	help
	  When enabled, the ESB subsystem automatically starts the required
	  HF clock and applies platform-specific errata workarounds during
	  initialization (esb_init()). This simplifies the application code by abstracting clock
	  control details. Disable this option if the application manages
	  clocks independently.

config ESB_DEFAULT_RF_CHANNEL
	int "Default channel"
	default 2
	range 0 100
	help
	  The default RF channel on which the ESB will operate if
	  "esb_set_rf_channel" function is not called.

module=ESB
module-str=ESB
source "$(ZEPHYR_BASE)/subsys/logging/Kconfig.template.log_config"

endif # NRF_ENHANCED_SHOCKBURST
```
